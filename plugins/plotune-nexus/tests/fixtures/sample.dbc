VERSION "sample"

NS_ :

BS_:

BU_: Vector__XXX ECU1 ECU2

BO_ 256 EngineData: 8 ECU1
 SG_ EngineSpeed : 0|16@1+ (0.125,0) [0|8000] "rpm" ECU2
 SG_ CoolantTemp : 16|8@1+ (1,-40) [-40|215] "degC" ECU2
 SG_ OverlapSignal : 8|16@1+ (1,0) [0|65535] "" ECU2

BO_ 256 DuplicateFrame: 8 ECU2
 SG_ BatteryVoltage : 0|16@1+ (0.01,0) [0|20] "V" ECU1

BA_ "GenMsgCycleTime" BO_ 256 10;
