AUTOSAR XML
package /Pkg
  application sw component type EngineSwc
    provide port SpeedOut: provided-interface=Pkg/SpeedIf
  sender receiver interface SpeedIf
  sender receiver interface SpeedIf
  application sw component type BodySwc
    require port MissingIn: required-interface=MissingIf
